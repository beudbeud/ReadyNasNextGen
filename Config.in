## Config.in
```kconfig
source "$BR2_EXTERNAL_READYNAS_NG_PATH/package/readynas-initramfs/Config.in"
source "$BR2_EXTERNAL_READYNAS_NG_PATH/package/diet/Config.in"
```

## package/diet/Config.in
```kconfig
config BR2_PACKAGE_DIET
	bool "diet (ReadyNAS Duo v1 web dashboard)"
	depends on BR2_USE_MMU # lighttpd
	depends on !BR2_STATIC_LIBS # lighttpd
	depends on BR2_PACKAGE_KSMBD_TOOLS
	depends on BR2_PACKAGE_NFS_UTILS
	select BR2_PACKAGE_LIGHTTPD
	select BR2_PACKAGE_LIGHTTPD_MBEDTLS
	select BR2_PACKAGE_MBEDTLS_PROGRAMS # gen_key, cert_write
	select BR2_PACKAGE_MDADM
	select BR2_PACKAGE_LIBCURL
	select BR2_PACKAGE_LIBCURL_CURL
	select BR2_PACKAGE_CA_CERTIFICATES
	help
	  DIET dashboard ported to Linux 6.18: /www page and CGI API
	  (busybox shell and awk) served by lighttpd over HTTPS
	  (self-signed certificate created at first boot), ksmbd
	  shares, NFS exports, users, disks (libata, drivetemp),
	  md RAID (/proc/mdstat, mdadm), padre-fan display and
	  settings, Telegram notifications, network, language,
	  time (ntpd), shutdown.
	  Enables in busybox: ntpd. HTTPS downloads (Telegram, system
	  updates) go through curl, which checks the certificates.
	  See docs/DIET.md.

comment "diet needs ksmbd-tools, nfs-utils and shared libraries"
	depends on !BR2_PACKAGE_KSMBD_TOOLS || !BR2_PACKAGE_NFS_UTILS || BR2_STATIC_LIBS
```

## package/readynas-initramfs/Config.in
```kconfig
config BR2_PACKAGE_READYNAS_INITRAMFS
	bool "readynas-initramfs"
	depends on BR2_LINUX_KERNEL
	help
	  Minimal initramfs built into the ReadyNAS Duo v1 kernel:
	  static busybox WITHOUT floating point (the Padre has no FPU)
	  and small tests (windows, load, float). The binaries go to
	  $(BINARIES_DIR)/readynas-initramfs, not to the target.
```

## package/readynas-tests/Config.in
```kconfig
config BR2_PACKAGE_READYNAS_TESTS
	bool "readynas-tests (Padre port tests)"
	help
	  Small tests to run on the ReadyNAS Duo v1 console:
	  test-flush (I-cache after code rewrite + floating point),
	  test-fp-s / test-fp-d / test-fp-n (FPU emulation, static,
	  dynamic PIE and dynamic non-PIE), test-align (unaligned integer
	  accesses emulated by the kernel, malloc alignment), test-ldso (dynamic programs
	  in a loop, counts ld-uClibc segfaults).
	  Installed in /usr/bin.
```

## package/smart-lite/Config.in
```kconfig
config BR2_PACKAGE_SMART_LITE
	bool "smart-lite (ATA SMART reader and self-test)"
	help
	  Small C tool reading SMART of libata disks through SG_IO and
	  ATA PASS-THROUGH (16): identity, attributes with thresholds,
	  overall health, temperature, self-test state; -t starts or
	  aborts a SMART self-test. Otherwise read-only commands only; a
	  disk in standby is left asleep unless -f. Replaces smartctl
	  (smartmontools needs C++, absent from the toolchain) for DIET.
	  Installed in /usr/sbin.
```

## package/xraid-compat/Config.in
```kconfig
config BR2_PACKAGE_XRAID_COMPAT
	bool "xraid-compat (ReadyNAS X-RAID read/write, switch to md)"
	depends on BR2_USE_MMU # lvm2, rsync
	depends on BR2_TOOLCHAIN_HAS_THREADS # lvm2
	depends on !BR2_STATIC_LIBS # lvm2 standard install
	select BR2_PACKAGE_LVM2
	select BR2_PACKAGE_LVM2_STANDARD_INSTALL
	select BR2_PACKAGE_MDADM
	select BR2_PACKAGE_E2FSPROGS
	select BR2_PACKAGE_E2FSPROGS_FUSE2FS
	select BR2_PACKAGE_E2FSPROGS_RESIZE2FS
	select BR2_PACKAGE_RSYNC
	help
	  X-RAID compatibility layer (ReadyNAS Duo v1, RAIDiator 4.x)
	  for Linux 6.18: xraid-info (read-only analysis of the "WGao"
	  superblock, mirror check, SMART), nas-raid (dm-linear + md
	  assembly without superblock, LVM, /c through fuse2fs;
	  migration to md) and S35storage.
	  Kernel: CONFIG_BLK_DEV_DM, CONFIG_MD_RAID1, CONFIG_FUSE_FS.
	  See docs/XRAID.md.

comment "xraid-compat needs a toolchain w/ threads, dynamic library"
	depends on BR2_USE_MMU
	depends on !BR2_TOOLCHAIN_HAS_THREADS || BR2_STATIC_LIBS
```
